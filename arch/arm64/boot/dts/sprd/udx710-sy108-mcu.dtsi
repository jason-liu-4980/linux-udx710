// SPDX-License-Identifier: GPL-2.0-only
/* 4H10 MCU wiring and raw reset/wake levels from the board driver. */
&{/soc/aon/serial@620e0000} {
	board_mcu: mcu {
		compatible = "meig,sy108-mcu";
		rst-mcu-gpios = <&p118 70 0>;
		wkup-mcu-gpios = <&p118 71 0>;
		#io-channel-cells = <1>;
	};
};
