// SPDX-License-Identifier: GPL-2.0-only
/* UDX710 CM4 SRAM window and its AON reset controller. */
/ {
	pmsys: remoteproc@b000 {
		compatible = "sprd,udx710-pmsys";
		reg = <0 0xb000 0 0xdc00>;
		sprd,aon-apb = <&p11>;
		status = "disabled";
	};
};
