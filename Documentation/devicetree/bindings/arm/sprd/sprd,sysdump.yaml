## Documentation/devicetree/bindings/arm/sprd/sprd,sysdump.yaml
```yaml
# SPDX-License-Identifier: (GPL-2.0-only OR BSD-2-Clause)
%YAML 1.2
---
$id: http://devicetree.org/schemas/arm/sprd/sprd,sysdump.yaml#
$schema: http://devicetree.org/meta-schemas/core.yaml#

title: Spreadtrum bootloader system dump memory selection

maintainers:
  - Orson Zhai <orsonzhai@gmail.com>
  - Baolin Wang <baolin.wang7@gmail.com>

description: |
  The installed bootloader finds /sprd-sysdump by path and reads the selected
  physical memory and reserved-region phandles during dump collection. The
  legacy property names are part of that interface.

select:
  properties:
    $nodename:
      const: sprd-sysdump
  required: [$nodename]

properties:
  memory-region:
    description: Physical memory node selected by the bootloader.
    maxItems: 1
  memory-region-re:
    $ref: /schemas/types.yaml#/definitions/phandle-array
    description: Reserved-region handles used by the legacy dump collector.
  memory-region-se:
    $ref: /schemas/types.yaml#/definitions/phandle-array
    description: Optional separately selected dump regions.
  version:
    $ref: /schemas/types.yaml#/definitions/uint32
    description: Legacy dump format selector; absent means version zero.

required: [memory-region]
additionalProperties: false
```

## Documentation/devicetree/bindings/clock/sprd,orca-clk.yaml
```yaml
# SPDX-License-Identifier: GPL-2.0-only OR BSD-2-Clause
%YAML 1.2
---
$id: http://devicetree.org/schemas/clock/sprd,orca-clk.yaml#
$schema: http://devicetree.org/meta-schemas/core.yaml#

title: Spreadtrum Orca clock controllers

maintainers:
  - Orson Zhai <orsonzhai@gmail.com>
  - Baolin Wang <baolin.wang7@gmail.com>
  - Chunyan Zhang <zhang.lyra@gmail.com>

description: |
  Clock controllers for the nine public Orca providers and the SP-AHB
  provider on Spreadtrum Orca (UDX710). The SP-AHB provider exposes clock
  ID 0, the SP UART0 gate. IDs are defined in
  dt-bindings/clock/sprd,orca-clk.h.

  The SP-AHB controller has a 0x3000-byte register window. Its UART gate
  uses bit 9 at offset 0, with set and clear aliases at offsets 0x1000
  and 0x2000. Preserve unused-clock state because firmware may also use
  this domain. Registering this provider does not establish UART interrupt
  ownership or implement the pmsys notification protocol.

  The current port retains global CCF parent-name lookup. The supplied board
  uses roots named ext-26m, ext-32k and rco-100m. The clocks property records
  the BSP connection but is not a generic replacement for those name-based
  dependencies. An arbitrary differently named clock phandle is not enough.
  clk-12m remains unresolved for two AON USB reference mux inputs. See the
  source guards for controls that are registered but not safe to program.

properties:
  compatible:
    enum:
      - sprd,orca-pmu-gate
      - sprd,orca-g3-pll
      - sprd,orca-apcpu-clk
      - sprd,orca-apahb-gate
      - sprd,orca-ap-clk
      - sprd,orca-apapb-gate
      - sprd,orca-ipa-gate
      - sprd,orca-spahb-gate
      - sprd,orca-aon-clk
      - sprd,orca-aon-gate

  reg:
    maxItems: 1

  sprd,syscon:
    $ref: /schemas/types.yaml#/definitions/phandle
    description: Syscon that owns the controller registers.

  clocks:
    maxItems: 1
    description: Board 26 MHz reference; current driver retains CCF name lookup.

  '#clock-cells':
    const: 1

required:
  - compatible
  - clocks
  - '#clock-cells'

oneOf:
  - required: [reg]
  - required: [sprd,syscon]

allOf:
  - if:
      properties:
        compatible:
          const: sprd,orca-spahb-gate
    then:
      required: [reg]
      properties:
        sprd,syscon: false

additionalProperties: false

examples:
  - |
    clock-controller@21100000 {
        compatible = "sprd,orca-ap-clk";
        reg = <0x21100000 0x1000>;
        clocks = <&ext_26m>;
        #clock-cells = <1>;
    };
...
```

## Documentation/devicetree/bindings/cpufreq/sprd,orca-cluster.yaml
```yaml
# SPDX-License-Identifier: (GPL-2.0-only OR BSD-2-Clause)
%YAML 1.2
---
$id: http://devicetree.org/schemas/cpufreq/sprd,orca-cluster.yaml#
$schema: http://devicetree.org/meta-schemas/core.yaml#

title: Spreadtrum Orca legacy CPU cluster firmware parameters

maintainers:
  - Orson Zhai <orsonzhai@gmail.com>
  - Baolin Wang <baolin.wang7@gmail.com>

description: |
  Parameters consumed through the CPU cpufreq-data-v1 phandle by the Orca
  secure-firmware DVFS driver. These are configuration arguments to the
  firmware service, not a static voltage/frequency table.

select:
  properties:
    $nodename:
      const: cpufreq-clus0
  required: [$nodename]

properties:
  voltage-step:
    $ref: /schemas/types.yaml#/definitions/uint32
    description: Firmware CONFIG voltage argument in microvolts.
  tuning-latency-us: true
  boost-duration:
    $ref: /schemas/types.yaml#/definitions/uint32
    const: 0
    description: Legacy boot boost interval; not supported by the SIP driver.

required: [voltage-step, tuning-latency-us, boost-duration]
additionalProperties: false
```

## Documentation/devicetree/bindings/cpufreq/sprd,orca-cpufreq.yaml
```yaml
# SPDX-License-Identifier: (GPL-2.0-only OR BSD-2-Clause)
%YAML 1.2
---
$id: http://devicetree.org/schemas/cpufreq/sprd,orca-cpufreq.yaml#
$schema: http://devicetree.org/meta-schemas/core.yaml#

title: Spreadtrum Orca secure-firmware CPU DVFS interface

maintainers:
  - Orson Zhai <orsonzhai@gmail.com>
  - Baolin Wang <baolin.wang7@gmail.com>

description: |
  The Orca AP CPU frequency driver obtains its CPU OPP frequency/voltage pairs
  through the secure SIP DVFS service (SMC32 fast calls 0x82000200..207).
  This is not the public BSP sprd,orca-cpudvfs MMIO interface. No reg or static
  operating-points property is required on this node. The secure firmware
  retained from the stock boot chain owns regulator and clock sequencing.

  Each CPU references its cluster parameter node with the legacy
  cpufreq-data-v1 phandle. The existing supported cluster0 parameter node
  provides voltage-step in microvolts, tuning-latency-us, and boost-duration
  equal to zero. The supplied board uses 750000, 200, and 0 respectively.
  These are firmware request parameters, not a CPU voltage OPP table.
  The driver obtains all actual frequency/voltage pairs from firmware.

properties:
  compatible:
    const: sprd,orca-cpufreq

required:
  - compatible

additionalProperties: false

examples:
  - |
    cpufreq {
        compatible = "sprd,orca-cpufreq";
    };
...
```

## Documentation/devicetree/bindings/devfreq/sprd,orca-ddr.yaml
```yaml
# SPDX-License-Identifier: (GPL-2.0-only OR BSD-2-Clause)
%YAML 1.2
---
$id: http://devicetree.org/schemas/devfreq/sprd,orca-ddr.yaml#
$schema: http://devicetree.org/meta-schemas/core.yaml#

title: Spreadtrum Orca firmware DDR frequency interface

maintainers:
  - Orson Zhai <orsonzhai@gmail.com>
  - Baolin Wang <baolin.wang7@gmail.com>

description: |
  The DDR driver queries the frequency table and current state through the
  PM_SYS SIPC control channel. Firmware owns frequency selection and training;
  this interface exposes monitoring through devfreq. No MMIO OPP table is
  supplied by this node.

properties:
  compatible:
    const: sprd,dfs
  freq-num:
    $ref: /schemas/types.yaml#/definitions/uint32
    minimum: 1
    description: Number of entries in the peer firmware's frequency table.

required: [compatible, freq-num]
additionalProperties: false
```

## Documentation/devicetree/bindings/iio/adc/meig,sy108-mcu.yaml
```yaml
# SPDX-License-Identifier: (GPL-2.0-only OR BSD-2-Clause)
%YAML 1.2
---
$id: http://devicetree.org/schemas/iio/adc/meig,sy108-mcu.yaml#
$schema: http://devicetree.org/meta-schemas/core.yaml#

title: SY108 board management MCU

description: |
  The SY108 MCU communicates over a 115200 baud, 8N1 UART. It exposes
  ADC channels 3 through 5 and reports board power and USB reset requests.
  The reset and wake GPIOs retain the levels required by the board firmware.

maintainers:
  - jason-liu-4980 <38558962+jason-liu-4980@users.noreply.github.com>

allOf:
  - $ref: /schemas/serial/serial-peripheral-props.yaml#

properties:
  compatible:
    const: meig,sy108-mcu

  rst-mcu-gpios:
    maxItems: 1
    description: MCU reset line, held low during normal operation.

  wkup-mcu-gpios:
    maxItems: 1
    description: MCU wake line, held high during normal operation.

  '#io-channel-cells':
    const: 1
    description: ADC channel number, from 3 through 5.

required:
  - compatible
  - rst-mcu-gpios
  - wkup-mcu-gpios
  - '#io-channel-cells'

unevaluatedProperties: false

examples:
  - |
    serial {
        mcu {
            compatible = "meig,sy108-mcu";
            rst-mcu-gpios = <&gpio 70 0>;
            wkup-mcu-gpios = <&gpio 71 0>;
            #io-channel-cells = <1>;
        };
    };
```

## Documentation/devicetree/bindings/mfd/sprd,sc27xx-syscon.yaml
```yaml
# SPDX-License-Identifier: (GPL-2.0-only OR BSD-2-Clause)
%YAML 1.2
---
$id: http://devicetree.org/schemas/mfd/sprd,sc27xx-syscon.yaml#
$schema: http://devicetree.org/meta-schemas/core.yaml#

title: Spreadtrum SC2730 legacy analog system registers

maintainers:
  - Orson Zhai <orsonzhai@gmail.com>
  - Baolin Wang <baolin.wang7@gmail.com>

description: |
  Legacy SC2730 descriptor for analog chip identification, charger detection
  and charger control. Register addresses are offsets in the parent ADI regmap.
  The SC2730 global register map names offsets 0x1800, 0x1ba0 and 0x1b98 as
  CHIP_ID_LOW, CHGR_DET_FGU_CTRL and CHGR_CTRL respectively. This node is kept
  as a hardware description; Linux functional children use the parent regmap.

properties:
  compatible:
    const: sprd,sc27xx-syscon
  reg:
    items:
      - description: Chip identification low register.
      - description: Charger detection and fuel gauge control register.
      - description: Charger control register.

required: [compatible, reg]
additionalProperties: false
```

## Documentation/devicetree/bindings/mfd/sprd,udx710-syscon.yaml
```yaml
# SPDX-License-Identifier: (GPL-2.0-only OR BSD-2-Clause)
%YAML 1.2
---
$id: http://devicetree.org/schemas/mfd/sprd,udx710-syscon.yaml#
$schema: http://devicetree.org/meta-schemas/core.yaml#

title: Unisoc UDX710 system and analog register banks

maintainers:
  - Orson Zhai <orsonzhai@gmail.com>
  - Baolin Wang <baolin.wang7@gmail.com>

description: |
  Register banks shared by the UDX710 clock, reset, PHY and coprocessor
  controllers. The AP/PMU/AON compatibles are retained platform interfaces.
  The analog G0/G1/G2/G3/G4/G5/G8/G9/G10/G11 and AP interrupt banks follow the
  UDX710 register map; each AP interrupt bank has the same register layout.

properties:
  compatible:
    items:
      - enum:
          - sprd,sys-ap-ahb
          - sprd,sys-ap-apb
          - sprd,sys-ap-ipa-ahb
          - sprd,sys-pmu-apb
          - sprd,sys-aon-apb
          - sprd,udx710-anlg-g0-syscon
          - sprd,udx710-anlg-g1-syscon
          - sprd,udx710-anlg-g10-syscon
          - sprd,udx710-anlg-g11-syscon
          - sprd,udx710-anlg-g2-syscon
          - sprd,udx710-anlg-g3-syscon
          - sprd,udx710-anlg-g4-syscon
          - sprd,udx710-anlg-g5-syscon
          - sprd,udx710-anlg-g8-syscon
          - sprd,udx710-anlg-g9-syscon
          - sprd,udx710-ap-intc-syscon
          - sprd,udx710-audcp-ahb-syscon
          - sprd,udx710-audcp-apb-syscon
          - sprd,udx710-dmc-mpu-syscon
          - sprd,udx710-pub-apb-syscon
      - const: syscon
  reg:
    maxItems: 1
  '#syscon-cells':
    const: 2
    description: Register offset and bit mask for legacy syscon specifiers.

required: [compatible, reg]
additionalProperties: false
```

## Documentation/devicetree/bindings/mmc/sprd,sdhci-r11.yaml
```yaml
# SPDX-License-Identifier: GPL-2.0 OR BSD-2-Clause
%YAML 1.2
---
$id: http://devicetree.org/schemas/mmc/sprd,sdhci-r11.yaml#
$schema: http://devicetree.org/meta-schemas/core.yaml#

title: Spreadtrum SDHCI controller

maintainers:
  - Orson Zhai <orsonzhai@gmail.com>
  - Baolin Wang <baolin.wang7@gmail.com>
  - Chunyan Zhang <zhang.lyra@gmail.com>

properties:
  compatible:
    enum:
      - sprd,sdhci-r11
      - sprd,sdhc-r11p1

  reg:
    maxItems: 1

  interrupts:
    maxItems: 1

  clocks:
    minItems: 2
    maxItems: 3

  clock-names:
    oneOf:
      - minItems: 2
        items:
          - const: sdio
          - const: enable
          - const: 2x_enable
      - items:
          - const: sdio_clk
          - const: sdio_clk_source
          - const: sdio_ahb_enable

  pinctrl-0:
    description: default/high speed pin control
    maxItems: 1

  pinctrl-1:
    description: UHS mode pin control
    maxItems: 1

  pinctrl-names:
    minItems: 1
    items:
      - const: default
      - const: state_uhs

patternProperties:
  "^sprd,phy-delay-(legacy|mmc-(ddr52|highspeed|hs[24]00|hs400es)|sd-(highspeed|uhs-sdr(50|104)))$":
    $ref: /schemas/types.yaml#/definitions/uint32-array
    items:
      - description: clock data write line delay value
      - description: clock read command line delay value
      - description: clock read data positive edge delay value
      - description: clock read data negative edge delay value
    description:
      PHY DLL delays are used to delay the data valid window, and align
      the window to the sampling clock. Each cell's delay value unit is
      cycle of the PHY clock.

  "^sprd,(legacy|mmchs|sdhs|sdr50|sdr104|ddr52|hs200|hs400|hs400es)-dly$":
    $ref: /schemas/types.yaml#/definitions/uint32-array
    minItems: 4
    maxItems: 4
    items:
      minimum: 0
      maximum: 255
    description: R11P1 write, command-read, positive-read and negative-read delay bytes.

required:
  - compatible
  - reg
  - interrupts
  - clocks
  - clock-names

allOf:
  - $ref: sdhci-common.yaml#

unevaluatedProperties: false

examples:
  - |
    #include <dt-bindings/clock/sprd,sc9860-clk.h>
    #include <dt-bindings/interrupt-controller/arm-gic.h>
    #include <dt-bindings/interrupt-controller/irq.h>

    mmc@50430000 {
      compatible = "sprd,sdhci-r11";
      reg = <0x50430000 0x1000>;
      interrupts = <GIC_SPI 41 IRQ_TYPE_LEVEL_HIGH>;

      clocks = <&aon_prediv CLK_EMMC_2X>,
               <&apahb_gate CLK_EMMC_EB>,
               <&aon_gate CLK_EMMC_2X_EN>;
      clock-names = "sdio", "enable", "2x_enable";

      pinctrl-0 = <&sd0_pins_default>;
      pinctrl-1 = <&sd0_pins_uhs>;
      pinctrl-names = "default", "state_uhs";

      bus-width = <8>;
      cap-mmc-hw-reset;
      mmc-hs400-enhanced-strobe;
      mmc-hs400-1_8v;
      mmc-hs200-1_8v;
      mmc-ddr-1_8v;
      non-removable;
      no-sdio;
      no-sd;

      sprd,phy-delay-mmc-ddr52 = <0x3f 0x75 0x14 0x14>;
      sprd,phy-delay-mmc-hs200 = <0x0 0x8c 0x8c 0x8c>;
      sprd,phy-delay-mmc-hs400 = <0x44 0x7f 0x2e 0x2e>;
      sprd,phy-delay-mmc-hs400es = <0x3f 0x3f 0x2e 0x2e>;
    };
...
```
