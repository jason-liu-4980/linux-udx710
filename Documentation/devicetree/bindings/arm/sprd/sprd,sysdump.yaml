## Documentation/devicetree/bindings/power/reset/sprd,sc2730-poweroff.yaml
```yaml
# SPDX-License-Identifier: (GPL-2.0-only OR BSD-2-Clause)
%YAML 1.2
---
$id: http://devicetree.org/schemas/power/reset/sprd,sc2730-poweroff.yaml#
$schema: http://devicetree.org/meta-schemas/core.yaml#
title: Spreadtrum SC2730 PMIC system power-off
maintainers:
  - Baolin Wang <baolin.wang@unisoc.com>
description: |
  SC2730 system power-off block under the ADI/SPI PMIC. The power-down
  sequence executes in the sleepable system power-off preparation phase,
  with PSCI as the final firmware fallback.
properties:
  compatible:
    const: sprd,sc2730-poweroff
  reg:
    items:
      - const: 0x1820
required: [compatible, reg]
additionalProperties: false
```

## Documentation/devicetree/bindings/remoteproc/sprd,udx710-modem.yaml
```yaml
# SPDX-License-Identifier: (GPL-2.0-only OR BSD-2-Clause)
%YAML 1.2
---
$id: http://devicetree.org/schemas/remoteproc/sprd,udx710-modem.yaml#
$schema: http://devicetree.org/meta-schemas/core.yaml#

title: Unisoc UDX710 modem subsystem

maintainers:
  - jason-liu-4980 <38558962+jason-liu-4980@users.noreply.github.com>

description: |
  The modem CP, V3 PHY and NR PHY share one boot lifecycle. All original
  raw firmware, DSP images, prepared NV and the modem command line must be
  loaded before any core is released. There is no ELF resource table.
  The reserved modem memory also contains SIPC and SIPA shared buffers;
  only the named image windows are loaded by this device.

properties:
  compatible:
    const: sprd,udx710-modem

  reg:
    minItems: 12
    maxItems: 12

  reg-names:
    items:
      - const: cp-iram
      - const: v3-iram
      - const: nr-iram
      - const: modem
      - const: v3phy
      - const: nrphy
      - const: nrdsp1
      - const: nrdsp2
      - const: deltanv
      - const: cpcmdline
      - const: fixnv
      - const: runnv

  memory-region:
    maxItems: 1

  firmware-name:
    description: Raw files in the same order as the nine image windows.
    minItems: 9
    maxItems: 9

  sprd,aon-apb:
    $ref: /schemas/types.yaml#/definitions/phandle
    description: AON APB syscon containing the core reset controls.

  sprd,pmu-apb:
    $ref: /schemas/types.yaml#/definitions/phandle
    description: PMU APB syscon containing sleep, shutdown and system reset controls.

  sprd,cp-iram-data:
    $ref: /schemas/types.yaml#/definitions/uint32-array
    description: Original CP ARM bootstrap instructions and literal data.
    minItems: 49
    maxItems: 49

  sprd,v3-iram-data:
    $ref: /schemas/types.yaml#/definitions/uint32-array
    description: Original V3 PHY ARM bootstrap instructions and literal data.
    minItems: 49
    maxItems: 49

  sprd,nr-iram-data:
    $ref: /schemas/types.yaml#/definitions/uint32-array
    description: Original NR PHY ARM bootstrap instructions and literal data.
    minItems: 49
    maxItems: 49

required:
  - compatible
  - reg
  - reg-names
  - memory-region
  - firmware-name
  - sprd,aon-apb
  - sprd,pmu-apb
  - sprd,cp-iram-data
  - sprd,v3-iram-data
  - sprd,nr-iram-data

additionalProperties: false
```

## Documentation/devicetree/bindings/remoteproc/sprd,udx710-pmsys.yaml
```yaml
# SPDX-License-Identifier: (GPL-2.0-only OR BSD-2-Clause)
%YAML 1.2
---
$id: http://devicetree.org/schemas/remoteproc/sprd,udx710-pmsys.yaml#
$schema: http://devicetree.org/meta-schemas/core.yaml#

title: Spreadtrum UDX710 PM_SYS Cortex-M4 firmware loader

maintainers:
  - jason-liu-4980 <38558962+jason-liu-4980@users.noreply.github.com>

description: |
  PM_SYS runs the board's original raw firmware through the firmware loader. Its
  Cortex-M4 remains held in reset until the SIPC mailbox receiver is
  registered.

properties:
  compatible:
    const: sprd,udx710-pmsys
  reg:
    maxItems: 1
  sprd,aon-apb:
    $ref: /schemas/types.yaml#/definitions/phandle
    description: AON APB syscon containing the PM_SYS reset register.
  firmware-name:
    $ref: /schemas/types.yaml#/definitions/string
    const: sprd/udx710-pmsys.bin
    description: Original raw firmware prepared by userspace.

required:
  - compatible
  - reg
  - sprd,aon-apb
  - firmware-name

additionalProperties: false
```

## Documentation/devicetree/bindings/reserved-memory/sprd,sysdump-uboot.yaml
```yaml
# SPDX-License-Identifier: (GPL-2.0-only OR BSD-2-Clause)
%YAML 1.2
---
$id: http://devicetree.org/schemas/reserved-memory/sprd,sysdump-uboot.yaml#
$schema: http://devicetree.org/meta-schemas/core.yaml#

title: Spreadtrum bootloader dump reservation

maintainers:
  - Orson Zhai <orsonzhai@gmail.com>
  - Baolin Wang <baolin.wang7@gmail.com>

description: |
  Legacy detour-mem reservation for the bootloader dump area. The installed
  bootloader searches for the sysdump-uboot node name and rewrites its range;
  the user-version SY108 fixup sets its size to zero. Preserve the legacy
  compatible and node name for that interface.

allOf:
  - $ref: reserved-memory.yaml#

properties:
  compatible:
    const: detour-mem
  reg:
    maxItems: 1

required: [compatible, reg]
unevaluatedProperties: false
```

## Documentation/devicetree/bindings/reset/sprd,orca-usb-reset.yaml
```yaml
# SPDX-License-Identifier: (GPL-2.0-only OR BSD-2-Clause)
%YAML 1.2
---
$id: http://devicetree.org/schemas/reset/sprd,orca-usb-reset.yaml#
$schema: http://devicetree.org/meta-schemas/core.yaml#
title: Spreadtrum Orca USB and PAM reset controller
maintainers:
  - Jiayong Yang <jiayong.yang@unisoc.com>
description: |
  Group 0 is USB0 AP AHB bit 1. Group 1 combines USB1 and PAM IPA AHB bits 0
  and 5 for PHY/controller startup. Reset 2 pulses only PAM bit 5 for
  accelerator reinitialization. PAM holds a controller runtime-PM reference
  and quiesces its DMA before using reset 2.
properties:
  compatible:
    const: sprd,orca-usb-reset
  '#reset-cells':
    const: 1
  sprd,ap-ahb:
    description: AP AHB system controller containing the USB0 reset bit.
    $ref: /schemas/types.yaml#/definitions/phandle
  sprd,ipa-ahb:
    description: IPA AHB system controller containing the USB1 and PAM reset bits.
    $ref: /schemas/types.yaml#/definitions/phandle
required: [compatible, '#reset-cells', 'sprd,ap-ahb', 'sprd,ipa-ahb']
additionalProperties: false
```

## Documentation/devicetree/bindings/serial/sprd,sc9836-uart-ex.yaml
```yaml
# SPDX-License-Identifier: (GPL-2.0-only OR BSD-2-Clause)
%YAML 1.2
---
$id: http://devicetree.org/schemas/serial/sprd,sc9836-uart-ex.yaml#
$schema: http://devicetree.org/meta-schemas/core.yaml#

title: Spreadtrum SP UART with PM system interrupt proxy

maintainers:
  - Orson Zhai <orsonzhai@gmail.com>
  - Baolin Wang <baolin.wang7@gmail.com>

description: |
  SP UART uses the PM system SIPC notification endpoint to deliver receive
  notifications. Its own interrupt is described for the hardware, but the
  Linux driver leaves interrupt ownership with the PM firmware. The driver
  retains the existing 26 MHz parent/rate rather than reprogramming shared
  clock domains. A serial peripheral may be attached as a child node.

allOf:
  - $ref: serial.yaml#

properties:
  compatible:
    const: sprd,sc9836-uart-ex
  reg:
    maxItems: 1
  interrupts:
    maxItems: 1
  clocks:
    maxItems: 3
  clock-names:
    items:
      - const: enable
      - const: uart
      - const: source

required: [compatible, reg, clocks, clock-names]
unevaluatedProperties: false
```

## Documentation/devicetree/bindings/soc/sprd/sprd,sipc.yaml
```yaml
# SPDX-License-Identifier: (GPL-2.0-only OR BSD-2-Clause)
%YAML 1.2
---
$id: http://devicetree.org/schemas/soc/sprd/sprd,sipc.yaml#
$schema: http://devicetree.org/meta-schemas/core.yaml#

title: Unisoc interprocessor message transport

maintainers:
  - jason-liu-4980 <38558962+jason-liu-4980@users.noreply.github.com>

description: |
  SIPC carries short messages and shared-memory ring control between the
  application processor and a remote processor. Mailbox channels identify
  hardware destinations; sprd,dst identifies the SIPC protocol peer.

properties:
  compatible:
    const: sprd,sipc
  sprd,name:
    $ref: /schemas/types.yaml#/definitions/string
    description: Transport name used in driver diagnostics.
  sprd,type:
    $ref: /schemas/types.yaml#/definitions/string
    enum: [mbox, pcie, ipi]
    description: Hardware notification transport.
  sprd,dst:
    $ref: /schemas/types.yaml#/definitions/uint32
    maximum: 8
    description: SIPC peer identifier.
  sprd,core:
    $ref: /schemas/types.yaml#/definitions/uint32
    description: Mailbox destination, matching the smsg channel argument.
  sprd,core_sensor:
    $ref: /schemas/types.yaml#/definitions/uint32
    description: Legacy sensor mailbox destination.
  sprd,client:
    $ref: /schemas/types.yaml#/definitions/uint32
    enum: [0, 1]
    description: PCIe host (zero) or client (one) side.
  sprd,ep-dev:
    $ref: /schemas/types.yaml#/definitions/uint32
    description: PCIe endpoint device index on the host side.
  sprd,ep-fun:
    $ref: /schemas/types.yaml#/definitions/uint32
    description: PCIe endpoint function index on the client side.
  sprd,rc-ctrl:
    $ref: /schemas/types.yaml#/definitions/phandle
    description: PCIe root controller for the transport.
  sprd,smem-type:
    $ref: /schemas/types.yaml#/definitions/uint32
    enum: [0, 1]
    description: Local (zero) or PCIe (one) shared memory.
  sprd,smem-info:
    $ref: /schemas/types.yaml#/definitions/uint32-array
    description: Local base, peer base, and size in bytes of the shared memory.
    items:
      - description: Local base
      - description: Peer base
      - description: Size in bytes
  sprd,high-offset:
    $ref: /schemas/types.yaml#/definitions/uint32-array
    description: High address offsets for local and peer shared memory.
    items:
      - description: Local offset
      - description: Peer offset
  sprd,pm-sys:
    $ref: /schemas/types.yaml#/definitions/phandle
    description: PM_SYS remote processor for this transport.
  mboxes:
    maxItems: 1
  mbox-names:
    const: smsg
  interrupts:
    maxItems: 1

required:
  - compatible
  - sprd,name
  - sprd,type
  - sprd,dst
  - sprd,smem-info

allOf:
  - if:
      properties:
        sprd,type:
          const: mbox
    then:
      required:
        - mboxes
        - mbox-names

additionalProperties: false
```

## Documentation/devicetree/bindings/soc/sprd/sprd,spipe.yaml
```yaml
# SPDX-License-Identifier: (GPL-2.0-only OR BSD-2-Clause)
%YAML 1.2
---
$id: http://devicetree.org/schemas/soc/sprd/sprd,spipe.yaml#
$schema: http://devicetree.org/meta-schemas/core.yaml#

title: Spreadtrum SIPC shared byte-ring pipe

maintainers:
  - Orson Zhai <orsonzhai@gmail.com>
  - Baolin Wang <baolin.wang7@gmail.com>

description: |
  Legacy SIPC shared-memory endpoint instantiated for the firmware ABI.
  These nodes describe protocol channels, not MMIO addresses. Destination
  and channel select the existing SIPC transport; buffer geometry must agree
  with the peer firmware.

properties:
  compatible:
    const: sprd,spipe
  sprd,name:
    $ref: /schemas/types.yaml#/definitions/string
    description: Userspace device name.
  sprd,dst:
    $ref: /schemas/types.yaml#/definitions/uint32
    description: SIPC destination ID.
  sprd,channel:
    $ref: /schemas/types.yaml#/definitions/uint32
    description: SMSG channel ID.
  sprd,ringnr:
    $ref: /schemas/types.yaml#/definitions/uint32
    description: Number of shared byte rings.
  sprd,size-rxbuf:
    $ref: /schemas/types.yaml#/definitions/uint32
    description: Receive ring capacity in bytes.
  sprd,size-txbuf:
    $ref: /schemas/types.yaml#/definitions/uint32
    description: Transmit ring capacity in bytes; zero is valid for receive-only pipes.

required:
  - compatible
  - sprd,name
  - sprd,dst
  - sprd,channel
  - sprd,ringnr
  - sprd,size-rxbuf
  - sprd,size-txbuf
additionalProperties: false
```
