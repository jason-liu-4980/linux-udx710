## Documentation/devicetree/bindings/mtd/sprd,orca-nandc.yaml
```yaml
# SPDX-License-Identifier: (GPL-2.0-only OR BSD-2-Clause)
%YAML 1.2
---
$id: http://devicetree.org/schemas/mtd/sprd,orca-nandc.yaml#
$schema: http://devicetree.org/meta-schemas/core.yaml#

title: Spreadtrum Orca NAND flash controller

maintainers:
  - Orson Zhai <orsonzhai@gmail.com>
  - Baolin Wang <baolin.wang7@gmail.com>

description: |
  Orca parallel NAND controller with hardware BCH ECC. The nine clocks name
  the NAND/ECC sources, selectable SDR/DDR parents and their separate gates.
  The current controller interface attaches one NAND chip at chip select zero.

allOf:
  - $ref: nand-controller.yaml#

properties:
  compatible:
    const: sprd,orca-nandc
  reg:
    maxItems: 1
  interrupts:
    maxItems: 1
  clocks:
    maxItems: 9
  clock-names:
    items:
      - const: nandc_clk
      - const: nandc_ecc_clk
      - const: nandc_parent_sdr
      - const: nandc_parent_ddr
      - const: nandc_ahb_enable
      - const: nandc_ecc_enable
      - const: nandc_26m_enable
      - const: nandc_1x_enable
      - const: nandc_2x_enable
  sprd,random-mode:
    type: boolean
    description: Enable the controller data randomizer for the board NAND format.

patternProperties:
  '^nand@[0-9a-f]+$':
    type: object
    $ref: raw-nand-chip.yaml#
    properties:
      reg:
        items:
          - const: 0
    unevaluatedProperties: false

required: [compatible, reg, clocks, clock-names]
unevaluatedProperties: false
```

## Documentation/devicetree/bindings/net/sprd,orca-sipa-delegate.yaml
```yaml
# SPDX-License-Identifier: (GPL-2.0-only OR BSD-2-Clause)
%YAML 1.2
---
$id: http://devicetree.org/schemas/net/sprd,orca-sipa-delegate.yaml#
$schema: http://devicetree.org/meta-schemas/core.yaml#

title: Unisoc ORCA SIPA CP resource delegate

maintainers:
  - jason-liu-4980 <38558962+jason-liu-4980@users.noreply.github.com>

description: |
  The delegate registers the CP producer and exchanges its resource
  request, grant and release messages over SIPC. SIPA and SIPC binding
  does not imply that CP has granted a resource request.

properties:
  compatible:
    enum:
      - sprd,orca-sipa-delegate
      - sprd,roc1-sipa-delegate
  reg:
    maxItems: 2
  reg-names:
    items:
      - const: mem-base
      - const: reg-base
  sprd,sipa:
    $ref: /schemas/types.yaml#/definitions/phandle
    description: SIPA supplying the resource manager and shared FIFOs.
  sprd,cp-transport:
    $ref: /schemas/types.yaml#/definitions/phandle
    description: PSCP SIPC transport used for resource protocol messages.
  sprd,ul-fifo-depth:
    $ref: /schemas/types.yaml#/definitions/uint32
    description: Number of descriptors in the CP uplink FIFO.
  sprd,dl-fifo-depth:
    $ref: /schemas/types.yaml#/definitions/uint32
    description: Number of descriptors in the CP downlink FIFO.

required:
  - compatible
  - reg
  - reg-names
  - sprd,sipa
  - sprd,cp-transport
  - sprd,ul-fifo-depth
  - sprd,dl-fifo-depth

additionalProperties: false
```

## Documentation/devicetree/bindings/net/sprd,orca-sipa.yaml
```yaml
# SPDX-License-Identifier: (GPL-2.0-only OR BSD-2-Clause)
%YAML 1.2
---
$id: http://devicetree.org/schemas/net/sprd,orca-sipa.yaml#
$schema: http://devicetree.org/meta-schemas/core.yaml#

title: Unisoc ORCA and ROC1 SIPA packet accelerator

maintainers:
  - jason-liu-4980 <38558962+jason-liu-4980@users.noreply.github.com>

description: |
  SIPA owns the hardware packet FIFOs and resource manager. ORCA uses a
  local CP producer; a PCIe transport can be explicitly selected for
  platforms that route packets through PCIe. Producer registration and
  resource grants are performed by the corresponding runtime delegate.

properties:
  compatible:
    enum:
      - sprd,orca-sipa
      - sprd,roc1-sipa
  reg:
    maxItems: 2
  reg-names:
    items:
      - const: glb-base
      - const: iram-base
  interrupts:
    maxItems: 1
  interrupt-names:
    const: local_ipa_irq
  sprd,modem:
    $ref: /schemas/types.yaml#/definitions/phandle
    description: Modem remote processor that owns the cellular channels.
  sprd,enable-syscon:
    $ref: /schemas/types.yaml#/definitions/phandle-array
    description: IPA enable syscon, register offset and enable bit mask.
    items:
      - items:
          - description: Syscon phandle
          - description: Register offset
          - description: Enable bit mask
  sprd,sipa-bypass-mode:
    $ref: /schemas/types.yaml#/definitions/uint32
    description: Hardware bypass mode selection.
    enum: [0, 1]
  sprd,tft-mode:
    type: boolean
    description: Use the traffic flow template mode.
  sprd,wiap-ul-dma:
    type: boolean
    description: Use Wi-Fi AP uplink DMA.
  sprd,need-through-pcie:
    type: boolean
    description: Route the remote USB producer through PCIe.
  sprd,cp-transport:
    $ref: /schemas/types.yaml#/definitions/phandle
    description: PCIe SIPC transport for a remote USB resource producer.
  sprd,from-pcie-no-mac:
    $ref: /schemas/types.yaml#/definitions/uint32
    description: Legacy receive PCIe framing flag.
    enum: [0, 1]
  sprd,to-pcie-no-mac:
    $ref: /schemas/types.yaml#/definitions/uint32
    description: Legacy transmit PCIe framing flag.
    enum: [0, 1]
  vpower-supply:
    description: Power supply for a standalone SIPA subsystem.

patternProperties:
  '^sprd,(usb|cp|wifi|ap-eth|ap-ip)-(dl|ul)-(tx|rx)$':
    $ref: /schemas/types.yaml#/definitions/uint32-array
    description: FIFO location (zero for DDR, one for IRAM) and descriptor count.
    items:
      - enum: [0, 1]
      - minimum: 0

required:
  - compatible
  - reg
  - reg-names
  - interrupts
  - interrupt-names
  - sprd,enable-syscon

allOf:
  - if:
      required:
        - sprd,need-through-pcie
    then:
      required:
        - sprd,cp-transport
    else:
      properties:
        sprd,cp-transport: false

additionalProperties: false
```

## Documentation/devicetree/bindings/net/sprd,udx710-wwan-at.yaml
```yaml
# SPDX-License-Identifier: (GPL-2.0-only OR BSD-2-Clause)
%YAML 1.2
---
$id: http://devicetree.org/schemas/net/sprd,udx710-wwan-at.yaml#
$schema: http://devicetree.org/meta-schemas/core.yaml#

title: Unisoc UDX710 native SBUF AT streams

maintainers:
  - jason-liu-4980 <38558962+jason-liu-4980@users.noreply.github.com>

description: |
  The PSCP SIPC destination 5 channel 6 contains 32 original shared-memory
  rings with 2048-byte RX and TX areas per ring. Ring 0 carries unsolicited
  AT notifications and ring 1 carries commands and responses. The remaining
  ring slots remain part of the firmware layout. Both AT ports belong to
  the same modem as the SIPA data links.

properties:
  compatible:
    const: sprd,udx710-wwan-at

  sprd,modem:
    $ref: /schemas/types.yaml#/definitions/phandle
    description: Modem platform device shared with the SIPA WWAN links.

required:
  - compatible
  - sprd,modem

additionalProperties: false

examples:
  - |
    modem-at {
        compatible = "sprd,udx710-wwan-at";
        sprd,modem = <&modem>;
    };
```

## Documentation/devicetree/bindings/nvmem/sprd,orca-efuse.yaml
```yaml
# SPDX-License-Identifier: GPL-2.0-only OR BSD-2-Clause
%YAML 1.2
---
$id: http://devicetree.org/schemas/nvmem/sprd,orca-efuse.yaml#
$schema: http://devicetree.org/meta-schemas/core.yaml#

title: Spreadtrum Orca public read-only eFuse

description: |
  The byte-addressed public region covers hardware blocks 2 through 46
  inclusive (180 bytes). Offset zero maps to hardware block 2. All public
  blocks use the redundant double-bit read mode. The 8-byte UID at offset
  0xb4 maps hardware blocks 0 and 1 in double-bit mode, with bit 31 of each
  word cleared as in the original UID format. Calibration offsets remain
  unchanged. The resulting read-only NVMEM view is 188 bytes. The driver
  provides no programming operation. Thermal calibration uses the standard NVMEM cell
  bits property; no calibrated values are encoded in this binding.

maintainers:
  - Orson Zhai <orsonzhai@gmail.com>
  - Baolin Wang <baolin.wang7@gmail.com>
  - Chunyan Zhang <zhang.lyra@gmail.com>

properties:
  compatible:
    const: sprd,orca-efuse

  reg:
    maxItems: 1

  clocks:
    maxItems: 1

  clock-names:
    const: enable

  hwlocks:
    maxItems: 1

  nvmem-layout:
    $ref: layouts/fixed-layout.yaml#

required:
  - compatible
  - reg
  - clocks
  - clock-names
  - hwlocks

allOf:
  - $ref: nvmem.yaml#

unevaluatedProperties: false

examples:
  - |
    #include <dt-bindings/clock/sprd,orca-clk.h>

    efuse@63400000 {
      compatible = "sprd,orca-efuse";
      reg = <0x63400000 0x10000>;
      clocks = <&aonapb_gate CLK_EFUSE_EB>;
      clock-names = "enable";
      hwlocks = <&hwlock 8>;
      nvmem-layout {
          compatible = "fixed-layout";
          #address-cells = <1>;
          #size-cells = <1>;

          uid@b4 {
            reg = <0xb4 0x8>;
          };

          /* Calibration cells */
          thermal_calib: calib@98 {
            reg = <0x98 0x4>;
            bits = <1 7>;
          };
      };
    };
...
```

## Documentation/devicetree/bindings/pci/sprd,orca-pcie.yaml
```yaml
# SPDX-License-Identifier: (GPL-2.0-only OR BSD-2-Clause)
%YAML 1.2
---
$id: http://devicetree.org/schemas/pci/sprd,orca-pcie.yaml#
$schema: http://devicetree.org/meta-schemas/core.yaml#

title: Spreadtrum Orca PCIe root complex

maintainers:
  - Orson Zhai <orsonzhai@gmail.com>
  - Baolin Wang <baolin.wang7@gmail.com>
  - Chunyan Zhang <zhang.lyra@gmail.com>

description: |
  Orca integrates a DesignWare root complex and an application register
  block in the DBI window. The transitional BSP sequence properties below
  retain the exact board-provided PLL, sleep and PERST sequencing while
  their ownership is converted to dedicated providers. They must not be
  combined with another owner writing the same control bits.

allOf:
  - $ref: /schemas/pci/snps,dw-pcie.yaml#

properties:
  compatible:
    const: sprd,orca-pcie

  reg:
    maxItems: 2

  reg-names:
    items:
      - const: dbi
      - const: config

  num-lanes:
    const: 1

  num-vectors:
    $ref: /schemas/types.yaml#/definitions/uint32
    enum: [32, 64, 96, 128, 160, 192, 224, 256]
    description: Number of vectors in the integrated MSI receiver.

  num-viewport:
    $ref: /schemas/types.yaml#/definitions/uint32
    description: Legacy BSP iATU window count; mainline detects the windows.
    deprecated: true

  interrupts:
    maxItems: 1

  interrupt-names:
    const: msi

  no-pcie:
    type: boolean
    description: Legacy board-disable flag; new boards should use status.
    deprecated: true

  dummy@0:
    type: object
    description: Legacy placement of the GIC MSI interrupt in the stock tree.
    properties:
      label:
        const: msi_int
      # The legacy width marker does not make this child a provider.
      interrupt-controller: false
      '#interrupt-cells':
        const: 3
        description: Legacy specifier-width marker matching the GIC parent.
      interrupts:
        maxItems: 1
    required:
      - label
      - interrupts
    additionalProperties: false
    deprecated: true

patternProperties:
  '^sprd,pcie-(startup|shutdown|suspend|resume|aspml1p2)-syscons$':
    $ref: /schemas/types.yaml#/definitions/phandle-array
    minItems: 1
    maxItems: 64
    items:
      items:
        - description: Syscon provider
        - description: Operation, 0 masked update, 1 forced masked write, 2 poll
          minimum: 0
          maximum: 2
        - description: Delay after this operation, in milliseconds
          maximum: 10000
        - description: Aligned byte offset inside the syscon resource
          multipleOf: 4
        - description: Nonzero register mask
          minimum: 1
        - description: Value restricted to the mask
    description: Ordered BSP syscon operations; poll has a bounded timeout.

required:
  - compatible
  - reg
  - reg-names
  - num-lanes
  - num-vectors
  - sprd,pcie-startup-syscons
  - sprd,pcie-shutdown-syscons
  - sprd,pcie-suspend-syscons
  - sprd,pcie-resume-syscons

oneOf:
  - required: [interrupts, interrupt-names]
  - required: [dummy@0]

unevaluatedProperties: false
```

## Documentation/devicetree/bindings/phy/sprd,orca-usb-phy.yaml
```yaml
# SPDX-License-Identifier: (GPL-2.0-only OR BSD-2-Clause)
%YAML 1.2
---
$id: http://devicetree.org/schemas/phy/sprd,orca-usb-phy.yaml#
$schema: http://devicetree.org/meta-schemas/core.yaml#
title: Spreadtrum Orca USB2 and USB3 analog PHY
maintainers:
  - Jiayong Yang <jiayong.yang@unisoc.com>
description: |
  Each instance contains both USB2 and USB3 functions. The same zero-cell
  phandle is supplied for both DWC3 PHY inputs. USB0 has its own reset, while
  USB1 shares a reset group with PAM. The driver holds shared analog settings
  while either port is active and applies the fixed host/peripheral role to
  each port separately. vdd-supply describes the PHY analog rail.
properties:
  compatible:
    enum: ['sprd,orca1-ssphy0', 'sprd,orca1-ssphy1']
  reg:
    maxItems: 1
  reg-names:
    const: ssphy_glb_regs
  '#phy-cells':
    const: 0
  resets:
    maxItems: 1
  vdd-supply: true
  sprd,vdd-voltage:
    description: PHY analog supply voltage in microvolts.
    $ref: /schemas/types.yaml#/definitions/uint32
    minimum: 1200000
    maximum: 3750000
  sprd,syscon-anag4:
    description: Shared analog control register bank.
    $ref: /schemas/types.yaml#/definitions/phandle
  sprd,syscon-aon-apb:
    description: Always-on APB control register bank used by the PHY.
    $ref: /schemas/types.yaml#/definitions/phandle
  sprd,syscon-ap-ahb:
    description: AP AHB control register bank used by USB0.
    $ref: /schemas/types.yaml#/definitions/phandle
  sprd,syscon-ipa-ahb:
    description: IPA AHB control register bank used by USB1.
    $ref: /schemas/types.yaml#/definitions/phandle
required:
  - compatible
  - '#phy-cells'
  - resets
  - vdd-supply
  - sprd,vdd-voltage
  - sprd,syscon-anag4
  - sprd,syscon-aon-apb
allOf:
  - if:
      properties:
        compatible:
          const: sprd,orca1-ssphy0
    then:
      required: ['sprd,syscon-ap-ahb']
    else:
      required: ['sprd,syscon-ipa-ahb']
additionalProperties: false
```
