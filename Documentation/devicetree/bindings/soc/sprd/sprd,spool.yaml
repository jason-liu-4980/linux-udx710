## Documentation/devicetree/bindings/soc/sprd/sprd,spool.yaml
```yaml
# SPDX-License-Identifier: (GPL-2.0-only OR BSD-2-Clause)
%YAML 1.2
---
$id: http://devicetree.org/schemas/soc/sprd/sprd,spool.yaml#
$schema: http://devicetree.org/meta-schemas/core.yaml#

title: Spreadtrum SIPC shared block pool

maintainers:
  - Orson Zhai <orsonzhai@gmail.com>
  - Baolin Wang <baolin.wang7@gmail.com>

description: |
  Legacy SIPC shared-memory endpoint instantiated for the firmware ABI.
  These nodes describe protocol channels, not MMIO addresses. Destination
  and channel select the existing SIPC transport; buffer geometry must agree
  with the peer firmware.

properties:
  compatible:
    const: sprd,spool
  sprd,name:
    $ref: /schemas/types.yaml#/definitions/string
    description: Userspace device name.
  sprd,dst:
    $ref: /schemas/types.yaml#/definitions/uint32
    description: SIPC destination ID.
  sprd,channel:
    $ref: /schemas/types.yaml#/definitions/uint32
    description: SMSG channel ID.
  sprd,tx-blksize:
    $ref: /schemas/types.yaml#/definitions/uint32
    description: TX block size in bytes.
  sprd,tx-blknum:
    $ref: /schemas/types.yaml#/definitions/uint32
    description: TX block count; zero is valid for an unused direction.
  sprd,rx-blksize:
    $ref: /schemas/types.yaml#/definitions/uint32
    description: RX block size in bytes.
  sprd,rx-blknum:
    $ref: /schemas/types.yaml#/definitions/uint32
    description: RX block count; zero is valid for an unused direction.
  sprd,preconfigured:
    $ref: /schemas/types.yaml#/definitions/uint32
    enum: [0, 1]
    description: Use the peer-preconfigured receive block pool.
  sprd,nodev:
    $ref: /schemas/types.yaml#/definitions/uint32
    enum: [0, 1]
    description: Do not create a userspace character device.

required:
  - compatible
  - sprd,name
  - sprd,dst
  - sprd,channel
  - sprd,tx-blksize
  - sprd,tx-blknum
  - sprd,rx-blksize
  - sprd,rx-blknum
additionalProperties: false
```

## Documentation/devicetree/bindings/soc/sprd/sprd,udx710-pmsys.yaml
```yaml
# SPDX-License-Identifier: (GPL-2.0-only OR BSD-2-Clause)
%YAML 1.2
---
$id: http://devicetree.org/schemas/soc/sprd/sprd,udx710-pmsys.yaml#
$schema: http://devicetree.org/meta-schemas/core.yaml#

title: Spreadtrum UDX710 PM_SYS Cortex-M4 firmware loader

maintainers:
  - jason-liu-4980 <38558962+jason-liu-4980@users.noreply.github.com>

description: |
  PM_SYS runs the board's original firmware from the named UBI volume. Its
  Cortex-M4 remains held in reset until the SIPC mailbox receiver is
  registered.

properties:
  compatible:
    const: sprd,udx710-pmsys
  reg:
    maxItems: 1
  sprd,aon-apb:
    $ref: /schemas/types.yaml#/definitions/phandle
    description: AON APB syscon containing the PM_SYS reset register.
  sprd,firmware-volume:
    $ref: /schemas/types.yaml#/definitions/string
    const: nr_pmsys
    description: Original firmware volume on the board's UBI device 0.

required:
  - compatible
  - reg
  - sprd,aon-apb
  - sprd,firmware-volume

additionalProperties: false
```

## Documentation/devicetree/bindings/sound/sprd,sc9860-mcdt.yaml
```yaml
# SPDX-License-Identifier: GPL-2.0-only OR BSD-2-Clause
%YAML 1.2
---
$id: http://devicetree.org/schemas/sound/sprd,sc9860-mcdt.yaml#
$schema: http://devicetree.org/meta-schemas/core.yaml#

title: Spreadtrum Multi-Channel Data Transfer controller

description:
  The Multi-channel data transfer controller is used for sound stream
  transmission between the audio subsystem and other AP/CP subsystem. It
  supports 10 DAC channels and 10 ADC channels, and each channel can be
  configured with DMA mode or interrupt mode.

maintainers:
  - Orson Zhai <orsonzhai@gmail.com>
  - Baolin Wang <baolin.wang7@gmail.com>
  - Chunyan Zhang <zhang.lyra@gmail.com>

properties:
  compatible:
    enum:
      - sprd,sc9860-mcdt
      - sprd,roc1-mcdt

  reg:
    maxItems: 1

  interrupts:
    maxItems: 1

  clocks:
    maxItems: 1
    description: Optional access clock, held while a channel is allocated.

  sprd,ap-addr-offset:
    $ref: /schemas/types.yaml#/definitions/uint32
    description:
      Offset subtracted from the AP physical FIFO address to obtain the
      address used by the ROC1 audio DMA controller.

allOf:
  - if:
      properties:
        compatible:
          const: sprd,sc9860-mcdt
    then:
      properties:
        sprd,ap-addr-offset: false

required:
  - compatible
  - reg
  - interrupts

additionalProperties: false

examples:
  - |
    #include <dt-bindings/interrupt-controller/arm-gic.h>
    #include <dt-bindings/interrupt-controller/irq.h>

    mcdt@41490000 {
      compatible = "sprd,sc9860-mcdt";
      reg = <0x41490000 0x170>;
      interrupts = <GIC_SPI 48 IRQ_TYPE_LEVEL_HIGH>;
    };
  - |
    #include <dt-bindings/interrupt-controller/arm-gic.h>

    mcdt@56490000 {
      compatible = "sprd,roc1-mcdt";
      reg = <0x56490000 0x170>;
      interrupts = <GIC_SPI 118 IRQ_TYPE_LEVEL_HIGH>;
      clocks = <&audio_access>;
      sprd,ap-addr-offset = <0x55000000>;
    };
...
```

## Documentation/devicetree/bindings/thermal/sprd,orca-aggregate-thermal.yaml
```yaml
# SPDX-License-Identifier: (GPL-2.0-only OR BSD-2-Clause)
%YAML 1.2
---
$id: http://devicetree.org/schemas/thermal/sprd,orca-aggregate-thermal.yaml#
$schema: http://devicetree.org/meta-schemas/core.yaml#

title: Spreadtrum Orca cluster and SoC aggregate temperature sensors

maintainers:
  - Orson Zhai <orsonzhai@gmail.com>
  - Baolin Wang <baolin.wang7@gmail.com>

description: |
  Legacy Orca board descriptions name the input thermal zones. If any input
  reaches 30000 millicelsius the output is the maximum input; otherwise the
  output is their arithmetic mean truncated towards zero. Cluster aggregates
  may consume only sprd,orca-thermal sensors and SoC aggregates may consume
  only sprd,cluster0-thermal providers. This enforces an acyclic dependency.

  Sensor IDs are specified by the consuming thermal-zone's thermal-sensors
  argument, not guessed from a unit address. The existing board uses ID15
  for cluster0 and ID17 for SoC. Legacy PID fields may remain for reference;
  this temperature provider does not implement a power/energy model or
  implicitly select the power_allocator governor.

properties:
  compatible:
    enum:
      - sprd,cluster0-thermal
      - sprd,soc-thermal
  "#thermal-sensor-cells":
    const: 1
  sensor-names:
    # The shared string-array type already enforces unique entries.
    $ref: /schemas/types.yaml#/definitions/string-array
    minItems: 1
    maxItems: 16
    description: Names of enabled child nodes below /thermal-zones.
  k-po:
    $ref: /schemas/types.yaml#/definitions/uint32
    deprecated: true
  k-pu:
    $ref: /schemas/types.yaml#/definitions/uint32
    deprecated: true
  k-i:
    $ref: /schemas/types.yaml#/definitions/uint32
    deprecated: true
  k-d:
    $ref: /schemas/types.yaml#/definitions/uint32
    deprecated: true
  cutoff:
    $ref: /schemas/types.yaml#/definitions/uint32
    deprecated: true

required:
  - compatible
  - "#thermal-sensor-cells"
  - sensor-names
additionalProperties: false
...
```

## Documentation/devicetree/bindings/thermal/sprd,orca-thermal.yaml
```yaml
# SPDX-License-Identifier: (GPL-2.0 OR BSD-2-Clause)
%YAML 1.2
---
$id: http://devicetree.org/schemas/thermal/sprd,orca-thermal.yaml#
$schema: http://devicetree.org/meta-schemas/core.yaml#

title: Unisoc Orca thermal sensor controller

maintainers:
  - Orson Zhai <orsonzhai@gmail.com>
  - Baolin Wang <baolin.wang7@gmail.com>
  - Chunyan Zhang <zhang.lyra@gmail.com>

$ref: thermal-sensor.yaml#

properties:
  compatible:
    const: sprd,orca-thermal

  reg:
    maxItems: 1

  clocks:
    minItems: 1
    maxItems: 2
    description:
      Bus enable gate followed optionally by the controller functional mux.
      On Orca the THM0/1/2 muxes select ext-32k or ext-26m divided by 104.
      Supplying the mux establishes clock ownership without changing its
      boot-selected parent or rate. Legacy gate-only descriptions are accepted;
      neither description by itself establishes the sampling period in seconds.

  clock-names:
    minItems: 1
    items:
      - const: enable
      - const: functional

  nvmem-cells:
    maxItems: 2
    description:
      One-bit sign and seven-bit ratio calibration values. Cells must provide
      little-endian, zero-extended values. An Orca-compatible NVMEM provider
      must interpret offsets as bytes, not fuse block numbers.

  nvmem-cell-names:
    items:
      - const: thm_sign_cal
      - const: thm_ratio_cal

  "#thermal-sensor-cells":
    const: 1

  "#address-cells":
    const: 1

  "#size-cells":
    const: 0

patternProperties:
  "^([a-z0-9]+-)?sensor@[0-7]$":
    type: object
    description:
      Represent one thermal sensor.

    properties:
      reg:
        description: Specify the sensor id.
        maxItems: 1

      nvmem-cells:
        maxItems: 1
        description:
          Eight-bit delta calibration, in 250 millicelsius steps around 128.
          The controller uses a nominal slope of 262 millicelsius per raw
          code and an offset of 66400 millicelsius.

      nvmem-cell-names:
        const: sen_delta_cal

    required:
      - reg
      - nvmem-cells
      - nvmem-cell-names

    additionalProperties: false

required:
  - compatible
  - reg
  - clocks
  - clock-names
  - nvmem-cells
  - nvmem-cell-names
  - "#address-cells"
  - "#size-cells"

unevaluatedProperties: false

examples:
  - |
    thermal@63410000 {
        compatible = "sprd,orca-thermal";
        reg = <0x63410000 0x10000>;
        clock-names = "enable";
        clocks = <&aonapb_gate 52>;
        #thermal-sensor-cells = <1>;
        nvmem-cells = <&thm0_sign>, <&thm0_ratio>;
        nvmem-cell-names = "thm_sign_cal", "thm_ratio_cal";
        #address-cells = <1>;
        #size-cells = <0>;

        prometheus-sensor@0 {
            reg = <0>;
            nvmem-cells = <&thm0_sen0>;
            nvmem-cell-names = "sen_delta_cal";
        };

        ank-sensor@1 {
            reg = <1>;
            nvmem-cells = <&thm0_sen1>;
            nvmem-cell-names = "sen_delta_cal";
        };
    };
...
```

## Documentation/devicetree/bindings/usb/sprd,orca-dwc3.yaml
```yaml
# SPDX-License-Identifier: (GPL-2.0-only OR BSD-2-Clause)
%YAML 1.2
---
$id: http://devicetree.org/schemas/usb/sprd,orca-dwc3.yaml#
$schema: http://devicetree.org/meta-schemas/core.yaml#
title: Spreadtrum Orca DesignWare USB3 fixed-role glue
maintainers:
  - Jiayong Yang <jiayong.yang@unisoc.com>
description: |
  The parent initializes the PHY and performs the shared reset before creating
  its DWC3 child. The child selects a fixed host or peripheral role.
properties:
  compatible:
    const: sprd,orca-dwc3
  reg:
    maxItems: 1
  '#address-cells':
    const: 2
  '#size-cells':
    const: 2
  ranges: true
  clocks:
    minItems: 3
    maxItems: 3
  clock-names:
    items:
      - const: core_clk
      - const: ref_clk
      - const: susp_clk
  phys:
    maxItems: 1
  phy-names:
    const: usb
patternProperties:
  '^usb@[0-9a-f]+$':
    $ref: snps,dwc3.yaml#
    properties:
      dr_mode:
        enum: [host, peripheral]
    required: [dr_mode]
required: [compatible, clocks, clock-names, phys, phy-names, ranges]
additionalProperties: false
```

## Documentation/devicetree/bindings/usb/sprd,orca-pamu3.yaml
```yaml
# SPDX-License-Identifier: (GPL-2.0-only OR BSD-2-Clause)
%YAML 1.2
---
$id: http://devicetree.org/schemas/usb/sprd,orca-pamu3.yaml#
$schema: http://devicetree.org/meta-schemas/core.yaml#

title: Unisoc ORCA PAM USB3 accelerator

maintainers:
  - jason-liu-4980 <38558962+jason-liu-4980@users.noreply.github.com>

description: |
  PAM connects the DWC3 endpoint DMA rings to SIPA. The supplier links
  describe devices needed to prepare the rings; remote CP resource grants
  and DMA completion remain runtime protocol events.

properties:
  compatible:
    const: sprd,orca-pamu3
  reg:
    maxItems: 1
  reg-names:
    const: pamu3_glb_regs
  clocks:
    maxItems: 1
  clock-names:
    const: pamu3_clk
  resets:
    maxItems: 1
  reset-names:
    const: pamu3
  sprd,dwc3:
    $ref: /schemas/types.yaml#/definitions/phandle
    description: DWC3 controller whose endpoints are used by PAM.
  sprd,sipa:
    $ref: /schemas/types.yaml#/definitions/phandle
    description: SIPA packet accelerator supplying the shared FIFO interface.

required:
  - compatible
  - reg
  - reg-names
  - clocks
  - clock-names
  - resets
  - reset-names
  - sprd,dwc3
  - sprd,sipa

additionalProperties: false
```

## Documentation/devicetree/bindings/watchdog/sprd,sc2730-wdt.yaml
```yaml
# SPDX-License-Identifier: GPL-2.0-only OR BSD-2-Clause
%YAML 1.2
---
$id: http://devicetree.org/schemas/watchdog/sprd,sc2730-wdt.yaml#
$schema: http://devicetree.org/meta-schemas/core.yaml#

title: Spreadtrum SC2730 PMIC watchdog

maintainers:
  - Jason Liu <jason-liu-4980@users.noreply.github.com>

description: |
  The SC2730 watchdog is a 32-bit counter clocked at 32768 Hz. It is a
  child of the PMIC and uses the parent ADI regmap. The reset-only driver
  preserves an inherited running watchdog and does not support stopping it.

allOf:
  - $ref: watchdog.yaml#

properties:
  compatible:
    const: sprd,sc2730-wdt

  reg:
    maxItems: 1

  timeout-sec:
    minimum: 1
    maximum: 131071
    default: 60

required:
  - compatible
  - reg

unevaluatedProperties: false
```

## drivers/phy/sprd/Kconfig
```kconfig
# SPDX-License-Identifier: GPL-2.0-only
config PHY_SPRD_ORCA_USB
	bool "Spreadtrum Orca USB PHY"
	depends on OF && (ARCH_SPRD || COMPILE_TEST)
	depends on REGULATOR && RESET_CONTROLLER
	select GENERIC_PHY
	select MFD_SYSCON
	help
	  Enable the USB2/USB3 analog PHY driver for Spreadtrum Orca (UDX710)
	  USB0 and USB1 controllers.
```

## drivers/pinctrl/sprd/Kconfig
```kconfig
# SPDX-License-Identifier: GPL-2.0-only
#
# Spreadtrum pin control drivers
#

config PINCTRL_SPRD
	tristate
	select PINMUX
	select PINCONF
	select GENERIC_PINCONF
	select GENERIC_PINMUX_FUNCTIONS
	help
	  Say Y here to enable Spreadtrum pinctrl driver

config PINCTRL_SPRD_SC9860
	tristate "Spreadtrum SC9860 pinctrl driver"
	depends on OF
	depends on ARCH_SPRD || COMPILE_TEST
	select PINCTRL_SPRD
	help
	  Say Y here to enable Spreadtrum SC9860 pinctrl driver

config PINCTRL_SPRD_ORCA
	tristate "Spreadtrum Orca pinctrl driver"
	depends on OF
	depends on ARCH_SPRD || COMPILE_TEST
	select PINCTRL_SPRD
	help
	  Enable the pin controller on Spreadtrum Orca (UDX710).
	  This provides global control fields, pin multiplexing and pad
	  configuration, including hardware-controlled sleep states.
	  If unsure, say N.
```

## drivers/soc/sprd/Kconfig
```kconfig
# SPDX-License-Identifier: GPL-2.0-only
source "drivers/soc/sprd/modem/sipc_v2/Kconfig"
```

## drivers/soc/sprd/modem/cproc/Kconfig
```kconfig
# SPDX-License-Identifier: GPL-2.0-only
config SPRD_CPROC
	bool "Experimental Spreadtrum AP communication processor loader"
	depends on ARM64 && OF && PROC_FS && SPRD_SIPC && EXPERT
	select MFD_SYSCON
	help
	  Preserve the vendor CPROC procfs boot, stop, image-load and status
	  interface, using the bootloader-supplied DT handoff and real syscons.
	  Built-in only; manual unbind is suppressed while complete CP reset
	  coordination and open-handle lifetime handling remain under review.
```
