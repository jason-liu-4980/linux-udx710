## drivers/soc/sprd/modem/sipc_v2/Kconfig
```kconfig
# SPDX-License-Identifier: GPL-2.0-only
config SPRD_SIPC
	bool "Experimental UDX710 local-peer SIPC v2 transport"
	depends on ARM64 && OF && MAILBOX && EXPERT && REMOTEPROC
	select GENERIC_ALLOCATOR
	help
	  AP-side SMSG, SMEM, SBUF and SBLOCK using the standard mailbox
	  framework. The captured local host PSCP, PM_SYS, NR_PHY, V3_PHY
	  and XC4500 peers are supported. PM_SYS uses its dedicated SRAM
	  mapping; modem peers use bounded DDR subpools. Other peers, PCIe
	  and client mode are rejected. This driver is
	  built-in only; unbind is suppressed while complete reset and
	  open-handle lifetime handling remains under development.

if SPRD_SIPC

config SPRD_SIPC_V2
	bool
	default y

config SPRD_SIPC_MBOX_CLIENT
	bool
	default y

config SPRD_SIPC_SPIPE
	bool "SIPC SBUF character devices"

config SPRD_SIPC_WWAN
	bool "UDX710 native SBUF WWAN AT ports"
	depends on WWAN=y
	help
	  Expose the original channel 6 URC and command rings as two WWAN
	  AT ports, grouped with SIPA under the modem platform device.

config SPRD_SIPC_SPOOL
	bool "SIPC SBLOCK character devices"

endif
```

## drivers/staging/sprd/Kconfig
```kconfig
menu "UDX710 AP packet transport"
source "drivers/staging/sprd/sipa/Kconfig"
source "drivers/staging/sprd/sipa_delegate/Kconfig"
endmenu
```

## drivers/staging/sprd/sipa/Kconfig
```kconfig
menu "SIPA modules"

config SPRD_SIPA
	bool "UDX710 SIPA AP packet transport"
	depends on NET && INET && OF && HAS_IOMEM
	select MFD_SYSCON
	default n
	help
	  SIPA is a module for spreadtrum ip packet accelator driver.

config SPRD_SIPA_USB_ACCEL
	bool "Vendor SIPA USB gadget acceleration"
	depends on SPRD_SIPA && USB_GADGET
	default y
	help
	  Preserve the existing vendor USB/PAMU3 acceleration path by default.
	  A diagnostic software profile may explicitly disable this option.
	  Keeping this disabled leaves the generic gether USB path intact,
	  while retaining SIPA cellular netdevs and the CP resource protocol.
	  This does not replace the SIPA modem packet transport with USB.

config SPRD_SIPA_WCN
	bool "Enable sipa for WCN"
	default n
	depends on SPRD_SIPA
	help
	  This option enables sipa interface for WCN.

config SPRD_IPA_PCIE_WORKROUND
	bool "Enable ipa pcie workround"
	default n
	depends on SPRD_SIPA
	help
	  This option enables sipa pcie workround.
          Orca ipa hardware limitations:
	  the sipc share memory must map from
	  0x280000000(orca side) to 0x80000000(roc1 side),
	  and the size must be 256M

config SPRD_SIPA_NF_FLOWTABLE
	bool "SIPA nft flowtable offload adapter"
	depends on SPRD_SIPA && NF_FLOW_TABLE && NET_CLS_ACT && EXPERT
	depends on ARM64 && !CPU_BIG_ENDIAN
	default n
	help
	  TC_SETUP_FT integration, IPv4/IPv6 TCP/UDP rule translation and
	  SIPA descriptor/DMA table construction.

endmenu
```

## drivers/staging/sprd/sipa_delegate/Kconfig
```kconfig
config SPRD_SIPA_DELEGATE
	bool "UDX710 local CP SIPA resource protocol"
	depends on SPRD_SIPA && SPRD_SIPC_V2
	default y

config SPRD_SIPA_DELE_CP_IN_MINIAP
	bool
	depends on SPRD_SIPA_DELEGATE
	default y
```
